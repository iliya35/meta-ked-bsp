## layers/meta-ktn-imx/conf/local.conf.sample
```bitbake
CONF_VERSION = "1"

# include version variables for source code
include sourcecode-version.conf

# =============================================
# ######### DISTRO ############################
# =============================================
# use our distro configuration from
# layers/meta-ktn/conf/distro/ktn.conf

DISTRO = "ktn"

# =============================================
# ######### MACHINE ###########################
# =============================================
# set a default MACHINE to build for
# usually this is overriden by the environment variable MACHINE
# (-m parameter of init-env exports MACHINE)

MACHINE ?= "kontron-mx8mm"

# =============================================
# ######### EXTRA FEATURES / ROOT PWD #########
# =============================================
# the default is to use the image feature `debug-tweaks` to remove the
# root password and add some packages (gdbserver, ptool, nano, etc.)
# remove it if you build a release image and set a root password
# by setting ROOT_PWD to a hashed password (`openssl passwd -1 password`)
# Note: you need to escape all '$' characters with '\' manually
# Note: the default value below is 'root'

EXTRA_IMAGE_FEATURES = "debug-tweaks"
#ROOT_PWD ?= "\$1\$/nrGReFp\$Emef9p70yRoahjHctKZ2p0"

# =============================================
# ######### SDK MACHINE #######################
# =============================================
# set a default SDKMACHINE
# possible values are "i686" and "x86_64" to build an SDK for
# 32-bit or 64-bit hosts respectively

SDKMACHINE ?= "x86_64"

# =============================================
# ######### SPECIAL OPTIONS/OVERRIDES #########
# =============================================
# set special options via MACHINEOVERRIDES

#MACHINEOVERRIDES .= ":option"

# =============================================
# ######### LICENSE / EULA RESTRICTIONS #######
# =============================================
# block/allow packages with certain licenses
# (e.g. commercial)

#LICENSE_FLAGS_WHITELIST = "commercial"

# for builds including software from Freescale/NXP you might
# need to accept their EULA

#ACCEPT_FSL_EULA = "1"

# =============================================
# ######### CACHE / DOWNLOAD PATHS ############
# =============================================
# set default locations for downloads and the sstate cache

DL_DIR ?= "${TOPDIR}/../downloads"
SSTATE_DIR ?= "${TOPDIR}/../sstate-cache"

# =============================================
# ######### PARALLEL TASKS / THREADING ########
# =============================================
# depending on your build host you might want to tweak
# the number of bitbake threads and parallel make tasks

BB_NUMBER_THREADS ?= "${@oe.utils.cpu_count()*2}"
PARALLEL_MAKE ?= "-j ${@oe.utils.cpu_count()}"

# =============================================
# ######### MISC ##############################
# =============================================
# uncomment to remove all temporary files after each build
# to save disk space

#INHERIT += "rm_work"
```

## layers/meta-ktn-imx/conf/machine/include/ktn-imx-common.inc
```bitbake
# Provides the common settings for Kontron i.MX HW

include conf/machine/include/imx-base.inc

PREFERRED_PROVIDER_virtual/kernel ?= "linux-ktn"
PREFERRED_PROVIDER_virtual/kernel_realtime ?= "linux-ktn-rt"
PREFERRED_VERSION_linux-ktn ?= "6.1"
PREFERRED_VERSION_linux-ktn-rt ?= "5.4"

PREFERRED_PROVIDER_u-boot ?= "u-boot-ktn"
PREFERRED_PROVIDER_virtual/bootloader ?= "u-boot-ktn"
PREFERRED_PROVIDER_u-boot-fw-utils ?= "u-boot-fw-utils"
PREFERRED_PROVIDER_u-boot-tools ?= "u-boot-imx-tools"
PREFERRED_VERSION_u-boot-ktn ?= "2022.10"
PREFERRED_VERSION_u-boot-fw-utils ?= "2021.07"

PREFERRED_PROVIDER_virtual/trusted-firmware-a ?= "imx-atf"

IMAGE_BOOT_FILES = " \
    fitImage \
"

UBOOT_CONFIG = "${MACHINE}"

UBOOT_INITIAL_ENV = "u-boot-initial-env"

SOC_DEFAULT_IMAGE_FSTYPES = "wic.gz wic.bmap tar.gz"

KERNEL_CLASSES ?= " kernel-fitimage "
KERNEL_IMAGETYPES ?= "fitImage"

# only set features that are common to all ktn machines
MACHINE_FEATURES = "usbhost vfat serial ext2"
```

## layers/meta-ktn-imx/conf/machine/include/ktn-mx6ul.inc
```bitbake
require conf/machine/include/tune-cortexa7.inc

MACHINEOVERRIDES =. "mx6:mx6ul:ktn-mx6ul:"

UBOOT_MAKE_TARGET ?= "flash.bin"
UBOOT_BINARY ?= "flash.bin"
UBOOT_SUFFIX ?= "bin"

UBOOT_DTB_LOADADDRESS ?= ""
UBOOT_LOADADDRESS ?= "0x81000000"

UBOOT_EXTLINUX_CONSOLE = "console=ttymxc3,115200"
UBOOT_EXTLINUX_ROOT = "root=/dev/mmcblk0p2"

WKS_FILE = "image-imx-ktn.wks"
IMX_BOOT_SEEK = "1"
WICVARS:append = " IMX_BOOT_SEEK UBOOT_BINARY"

UBOOT_ENTRYPOINT:mx6ul:remove = "0x10008000"
UBOOT_ENTRYPOINT:ktn-mx6ul:append = "${UBOOT_LOADADDRESS}"
```

## layers/meta-ktn-imx/conf/machine/include/ktn-mx8mm.inc
```bitbake
include conf/machine/include/tune-cortexa53.inc
include conf/machine/include/arm/armv8a/tune-cortexa53.inc

MACHINEOVERRIDES =. "mx8:mx8m:mx8mm:ktn-mx8mm:"

# Mainline BSP defaults to "generic" cortexa53 configuration,
# adjust it here to include crypto extension which enables
# inline NEON and FPU code generation
DEFAULTTUNE:use-mainline-bsp = "cortexa53-crypto"

UBOOT_BINARY ?= "flash.bin"
UBOOT_SUFFIX ?= "bin"

TFA_PLATFORM = "imx8mm"
TFA_BINARY = "bl31-imx8mm.bin"
TFA_BUILD_TARGET = "bl31"
DDR_FIRMWARE_NAME = "lpddr4_pmu_train_1d_imem.bin \
		     lpddr4_pmu_train_1d_dmem.bin \
		     lpddr4_pmu_train_2d_imem.bin \
		     lpddr4_pmu_train_2d_dmem.bin"

UBOOT_EXTLINUX_CONSOLE = "console=ttymxc2,115200"
UBOOT_EXTLINUX_ROOT = "root=/dev/mmcblk1p2"

WKS_FILE = "image-imx-ktn.wks"
IMX_BOOT_SEEK = "33"
WICVARS:append = " IMX_BOOT_SEEK UBOOT_BINARY"
WKS_FILE_DEPENDS:remove = "imx-boot"

UBOOT_ENTRYPOINT:mx8mm:remove = "0x40480000"
UBOOT_ENTRYPOINT:ktn-mx8mm:append = "0x40400000"
```

## layers/meta-ktn-imx/conf/machine/kontron-mx6ul.conf
```bitbake
#@TYPE: Machine
#@NAME: Kontron N63XX/N64XX Boards with SoM
#@SOC: i.MX6UL/i.MX6ULL
#@DESCRIPTION: Machine configuration for Kontron N63XX/N64XX Boards with SoM
#@MAINTAINER: 

require conf/machine/include/ktn-mx6ul.inc
require conf/machine/include/ktn-imx-common.inc

MACHINEOVERRIDES .= ":use-mainline-bsp"
MACHINE_FEATURES += "rtc pwm-buzzer can usbgadget emmc nandflash wifi screen"

KERNEL_DEVICETREE = " \
	imx6ul-kontron-bl.dtb \
	imx6ul-kontron-dl.dtb \
	imx6ull-kontron-bl.dtb \
	imx6ull-kontron-dl.dtb \
"

UBOOT_CONFIG[kontron-mx6ul] = "kontron-sl-mx6ul_defconfig"

SERIAL_CONSOLES = "115200;ttymxc3"

UBOOT_EXTLINUX_LABELS = "imx6ul-kontron-bl imx6ul-kontron-dl imx6ull-kontron-bl imx6ull-kontron-dl"
UBOOT_EXTLINUX_KERNEL_IMAGE_imx6ul-kontron-bl = "../fitImage#conf-imx6ul-kontron-bl.dtb"
UBOOT_EXTLINUX_KERNEL_IMAGE_imx6ul-kontron-dl = "../fitImage#conf-imx6ul-kontron-dl.dtb"
UBOOT_EXTLINUX_KERNEL_IMAGE_imx6ull-kontron-bl = "../fitImage#conf-imx6ull-kontron-bl.dtb"
UBOOT_EXTLINUX_KERNEL_IMAGE_imx6ull-kontron-dl = "../fitImage#conf-imx6ull-kontron-dl.dtb"
UBOOT_EXTLINUX_MENU_DESCRIPTION_imx6ul-kontron-bl = "Kontron BL i.MX6UL"
UBOOT_EXTLINUX_MENU_DESCRIPTION_imx6ul-kontron-dl = "Kontron DL i.MX6UL"
UBOOT_EXTLINUX_MENU_DESCRIPTION_imx6ull-kontron-bl = "Kontron BL i.MX6ULL"
UBOOT_EXTLINUX_MENU_DESCRIPTION_imx6ull-kontron-dl = "Kontron DL i.MX6ULL"
```

## layers/meta-ktn-imx/conf/machine/kontron-mx8mm.conf
```bitbake
#@TYPE: Machine
#@NAME: Kontron N80XX boards with i.MX8M-Mini SoC
#@SOC: i.MX8MM
#@DESCRIPTION: Machine configuration for Kontron N80XX boards with i.MX8M-Mini SoC
#@MAINTAINER: 

require conf/machine/include/ktn-mx8mm.inc
require conf/machine/include/ktn-imx-common.inc

MACHINE_FEATURES += "rtc pwm-buzzer can usbgadget emmc wifi screen"

KERNEL_DEVICETREE = " \
	freescale/imx8mm-kontron-bl.dtb \
	freescale/imx8mm-kontron-dl.dtb \
	freescale/imx8mm-kontron-bl-osm-s.dtb \
	freescale/imx8mm-kontron-dl-osm-s.dtb \
	freescale/imx8mm-kontron-bl-extension.dtbo \
	"

UBOOT_CONFIG[kontron-mx8mm] = "kontron-sl-mx8mm_defconfig"

SERIAL_CONSOLES = "115200;ttymxc2"
```
