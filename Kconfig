## Kconfig
```kconfig
mainmenu "Meta Kontron Build Configuration"

choice
    prompt "Hardware Platform"
    default HW_IMX6UL

config HW_IMX6UL
    bool "Kontron Electronics SL/BL i.MX6UL/ULL"

config HW_IMX8MM
    bool "Kontron Electronics SL/BL/OSM i.MX8MM"

endchoice

choice
    prompt "Yocto/OE Series"
    default SERIES_KIRKSTONE

config SERIES_DUNFELL
    bool "Yocto Dunfell"

config SERIES_KIRKSTONE
    bool "Yocto Kirkstone"

endchoice

config HEAD_BUILD
    bool "Use latest HEAD of all layers"

config SHARED_CACHE
    bool "Use a shared sstate cache mirror"

config PRODUCTION
    bool "Enable Production Build Options"

config KAS_INCLUDE_HW
    string
    default "kas/ked-mx6ul.yml" if HW_IMX6UL
    default "kas/ked-mx8mm.yml" if HW_IMX8MM

config KAS_INCLUDE_SERIES
    string
    default "kas/series/dunfell.yml" if SERIES_DUNFELL
    default "kas/series/kirkstone.yml" if SERIES_KIRKSTONE

config KAS_INCLUDE_HEAD
    string
    default "kas/dev/head-dunfell.yml" if SERIES_DUNFELL && HEAD_BUILD
    default "kas/dev/head-kirkstone.yml" if SERIES_KIRKSTONE && HEAD_BUILD
    depends on PRODUCTION

config KAS_INCLUDE_CACHE
    string
    default "kas/dev/shared-cache.yml"
    depends on SHARED_CACHE

config KAS_INCLUDE_PROD
    string
    default "kas/production.yml"
    depends on PRODUCTION
```

## layers/meta-ked-imx/conf/layer.conf
```bitbake
# We have a conf and classes directory, add to BBPATH
BBPATH .= ":${LAYERDIR}"

# We have a packages directory, add to BBFILES
BBFILES += "${LAYERDIR}/recipes-*/*/*.bb \
            ${LAYERDIR}/recipes-*/*/*.bbappend"

BBFILE_COLLECTIONS += "ked-imx"
BBFILE_PATTERN_ked-imx := "^${LAYERDIR}/"
BBFILE_PRIORITY_ked-imx = "11"

# Let us add layer-specific bbappends which are only applied when that
# layer is included in our configuration
BBFILES += "${@' '.join('${LAYERDIR}/%s/recipes*/*/*.bbappend' % layer \
               for layer in BBFILE_COLLECTIONS.split())}"

# Let us add layer-specific bbs which are only applied when that
# layer is included in our configuration
BBFILES += "${@' '.join('${LAYERDIR}/%s/recipes*/*/*.bb' % layer \
               for layer in BBFILE_COLLECTIONS.split())}"

# Let us add series-specific bbappends which are only applied if
# BASE_SERIES is set accordingly
BBFILES += "${LAYERDIR}/series-compat/${BASE_SERIES}/recipes*/*/*.bbappend"

# Let us add series-specific bbs which are only applied if
# BASE_SERIES is set accordingly
BBFILES += "${LAYERDIR}/series-compat/${BASE_SERIES}/recipes*/*/*.bb"

LAYERVERSION_ked-imx = "1"
LAYERSERIES_COMPAT_ked-imx = "dunfell kirkstone"
LAYERDEPENDS_ked-imx = "ked freescale-layer"
LAYERDEPENDS_ked-imx:append:mx8m-nxp-bsp = " meta-arm"
```

## layers/meta-ked-imx/conf/machine/include/ked-mx6ul.inc
```bitbake
include conf/machine/include/tune-cortexa7.inc
include conf/machine/include/arm/armv7a/tune-cortexa7.inc

MACHINEOVERRIDES =. "ked-mx6ul:ked-mx6:ked-imx:mx6ul:mx6:"

UBOOT_MAKE_TARGET ?= "flash.bin"
UBOOT_BINARY ?= "flash.bin"
UBOOT_SUFFIX ?= "bin"

UBOOT_DTB_LOADADDRESS ?= ""
UBOOT_LOADADDRESS ?= "0x81000000"

UBOOT_EXTLINUX_CONSOLE = "console=ttymxc3,115200"
UBOOT_EXTLINUX_ROOT = "root=/dev/mmcblk0p2"

WKS_FILE = "image-imx-ked.wks"
IMX_BOOT_SEEK = "1"
WICVARS:append = " IMX_BOOT_SEEK UBOOT_BINARY"

UBOOT_ENTRYPOINT = "${UBOOT_LOADADDRESS}"
UBOOT_ENTRYPOINT:mx6ul-generic-bsp  = "${UBOOT_LOADADDRESS}"
UBOOT_ENTRYPOINT:mx6ull-generic-bsp = "${UBOOT_LOADADDRESS}"
```

## layers/meta-ked-imx/conf/machine/include/ked-mx8mm.inc
```bitbake
include conf/machine/include/tune-cortexa53.inc
include conf/machine/include/arm/armv8a/tune-cortexa53.inc

MACHINEOVERRIDES =. "ked-mx8mm:ked-mx8m:ked-imx:mx8mm:mx8m:"

# Mainline BSP defaults to "generic" cortexa53 configuration,
# adjust it here to include crypto extension which enables
# inline NEON and FPU code generation
DEFAULTTUNE:use-mainline-bsp = "cortexa53-crypto"

UBOOT_BINARY ?= "flash.bin"
UBOOT_SUFFIX ?= "bin"
UBOOT_MAKE_TARGET ?= "flash.bin"

TFA_PLATFORM = "imx8mm"
TFA_BINARY = "bl31-imx8mm.bin"
TFA_BUILD_TARGET = "bl31"
ATF_BOOT_UART_BASE = "0x30880000"
DDR_FIRMWARE_NAME = "lpddr4_pmu_train_1d_imem.bin \
		     lpddr4_pmu_train_1d_dmem.bin \
		     lpddr4_pmu_train_2d_imem.bin \
		     lpddr4_pmu_train_2d_dmem.bin"

UBOOT_EXTLINUX_CONSOLE = "console=ttymxc2,115200"
UBOOT_EXTLINUX_ROOT = "root=/dev/mmcblk1p2"

WKS_FILE = "image-imx-ked.wks"
IMX_BOOT_SEEK = "33"
WICVARS:append = " IMX_BOOT_SEEK UBOOT_BINARY"
WKS_FILE_DEPENDS:remove = "imx-boot"

UBOOT_ENTRYPOINT = "0x40400000"
UBOOT_ENTRYPOINT:mx8m-generic-bsp = "0x40400000"

UBOOT_DTB_LOADADDRESS = "0x48000000"
UBOOT_DTBO_LOADADDRESS = "0x49000000"
```

## layers/meta-ked-imx/conf/machine/include/ked-mx8mp.inc
```bitbake
include conf/machine/include/tune-cortexa53.inc
include conf/machine/include/arm/armv8a/tune-cortexa53.inc

MACHINEOVERRIDES =. "ked-mx8mp:ked-mx8m:ked-imx:mx8mp:mx8m:"

# Mainline BSP defaults to "generic" cortexa53 configuration,
# adjust it here to include crypto extension which enables
# inline NEON and FPU code generation
DEFAULTTUNE:use-mainline-bsp = "cortexa53-crypto"

UBOOT_BINARY ?= "flash.bin"
UBOOT_SUFFIX ?= "bin"
UBOOT_MAKE_TARGET ?= "flash.bin"

TFA_PLATFORM = "imx8mp"
TFA_BINARY = "bl31-imx8mp.bin"
TFA_BUILD_TARGET = "bl31"
ATF_BOOT_UART_BASE = "0x30880000"
DDR_FIRMWARE_NAME = "lpddr4_pmu_train_1d_imem_202006.bin \
		     lpddr4_pmu_train_1d_dmem_202006.bin \
		     lpddr4_pmu_train_2d_imem_202006.bin \
		     lpddr4_pmu_train_2d_dmem_202006.bin"

WKS_FILE = "image-imx-ked.wks"
IMX_BOOT_SEEK = "32"
WICVARS:append = " IMX_BOOT_SEEK UBOOT_BINARY"
WKS_FILE_DEPENDS:remove = "imx-boot"

UBOOT_ENTRYPOINT = "0x40400000"
UBOOT_ENTRYPOINT:mx8m-generic-bsp = "0x40400000"

UBOOT_DTB_LOADADDRESS = "0x48000000"
UBOOT_DTBO_LOADADDRESS = "0x49000000"
```

## layers/meta-ked-imx/conf/machine/include/ktn-imx-common.inc
```bitbake
# Provides the common settings for Kontron i.MX HW

include conf/machine/include/imx-base.inc

PREFERRED_PROVIDER_virtual/kernel ?= "linux-ktn"
PREFERRED_VERSION_linux-ktn ?= "6.1"

PREFERRED_PROVIDER_u-boot ?= "u-boot-ktn"
PREFERRED_PROVIDER_virtual/bootloader ?= "u-boot-ktn"
PREFERRED_PROVIDER_u-boot-fw-utils ?= "u-boot-fw-utils"
PREFERRED_PROVIDER_u-boot-tools ?= "u-boot-imx-tools"
PREFERRED_VERSION_u-boot-ktn ?= "2023.04"
PREFERRED_VERSION_u-boot-fw-utils ?= "2021.07"

PREFERRED_PROVIDER_virtual/trusted-firmware-a ?= "imx-atf"

IMAGE_BOOT_FILES = " \
    fitImage \
"

UBOOT_CONFIG = "${MACHINE}"

UBOOT_INITIAL_ENV = "u-boot-initial-env"

SOC_DEFAULT_IMAGE_FSTYPES = "wic.gz wic.bmap tar.gz"

KERNEL_CLASSES ?= " kernel-fitimage "
KERNEL_IMAGETYPES ?= "fitImage"

# only set features that are common to all machines
MACHINE_FEATURES = "usbhost vfat serial ext2"
```

## layers/meta-ked-imx/conf/machine/kontron-mx8mp.conf
```bitbake
#@TYPE: Machine
#@NAME: Kontron OSM-S and BL boards with i.MX8M-Plus SoC
#@SOC: i.MX8MP
#@DESCRIPTION: Machine configuration for Kontron OSM-S/BL i.MX8MP
#@MAINTAINER: 

require conf/machine/include/ked-mx8mp.inc
require conf/machine/include/ked-imx-common.inc

MACHINE_FEATURES += "rtc pwm-buzzer can usbgadget emmc wifi screen"

KERNEL_DEVICETREE = " \
	freescale/imx8mp-kontron-bl-osm-s.dtb \
	freescale/imx8mp-kontron-dl.dtbo \
	"

UBOOT_CONFIG[kontron-mx8mp] = "kontron-osm-s-mx8mp_defconfig"

SERIAL_CONSOLES = "115200;ttymxc2"
```

## layers/meta-ked-stm32mp/conf/machine/include/extlinux-t1000-k-sparkle.inc
```bitbake
# =========================================================================
# Extlinux boot commands for
# Board: stm32mp-t1000-k-sparkle
# =========================================================================
# Define boot command lines
#
# The following bootschemes are supported
# - boot from sdcard (BOOTPIN_0,2=1, BOOTPIN_1=0)
# - boot from nor (BOOTPIN_0=1, BOOTPIN_3,2=0)
#   When booting from nor u-boot variable 'boot_targets' select where to find
#   the bootfs with EXTLINUX configuration
#

# add targets to generate
UBOOT_EXTLINUX_TARGETS += "\
	stm32mp-t1000-k-sparkle_sdcard \
	stm32mp-t1000-k-sparkle_nor-emmc \
	stm32mp-t1000-k-sparkle_nor-nand \
"

# definitions for this target *_sdcard boot
UBOOT_EXTLINUX_BOOTPREFIXES_stm32mp-t1000-k-sparkle_sdcard    = "mmc0_stm32mp-t1000-k-sparkle_"
UBOOT_EXTLINUX_LABELS_stm32mp-t1000-k-sparkle_sdcard          = "stm32mp-t1000-k-sparkle-sdcard"
UBOOT_EXTLINUX_DEFAULT_LABEL_stm32mp-t1000-k-sparkle_sdcard   = "stm32mp-t1000-k-sparkle-sdcard"
# label t1000-k-sparkle
UBOOT_EXTLINUX_FDT_stm32mp-t1000-k-sparkle-sdcard             = "/boot/stm32mp-t1000-k-sparkle.dtb"
UBOOT_EXTLINUX_ROOT_stm32mp-t1000-k-sparkle-sdcard            = "root=/dev/mmcblk0p4"

# definitions for this target *_nor-emmc boot
UBOOT_EXTLINUX_BOOTPREFIXES_stm32mp-t1000-k-sparkle_nor-emmc  = "mmc1_stm32mp-t1000-k-sparkle_"
UBOOT_EXTLINUX_LABELS_stm32mp-t1000-k-sparkle_nor-emmc        = "stm32mp-t1000-k-sparkle-nor-emmc"
UBOOT_EXTLINUX_DEFAULT_LABEL_stm32mp-t1000-k-sparkle_nor-emmc = "stm32mp-t1000-k-sparkle-nor-emmc"
# label t1000-k-sparkle
UBOOT_EXTLINUX_FDT_stm32mp-t1000-k-sparkle-nor-emmc           = "/boot/stm32mp-t1000-k-sparkle.dtb"
UBOOT_EXTLINUX_ROOT_stm32mp-t1000-k-sparkle-nor-emmc          = "root=/dev/mmcblk1p1"

# definitions for this target *_nor-nand boot
UBOOT_EXTLINUX_BOOTPREFIXES_stm32mp-t1000-k-sparkle_nor-nand  = "ubi0_stm32mp-t1000-k-sparkle_"
UBOOT_EXTLINUX_LABELS_stm32mp-t1000-k-sparkle_nor-nand        = "stm32mp-t1000-k-sparkle-nor-nand"
UBOOT_EXTLINUX_DEFAULT_LABEL_stm32mp-t1000-k-sparkle_nor-nand = "stm32mp-t1000-k-sparkle-nor-nand"
# label t1000-k-sparkle
UBOOT_EXTLINUX_FDT_stm32mp-t1000-k-sparkle-nor-nand           = "/boot/stm32mp-t1000-k-sparkle.dtb"
UBOOT_EXTLINUX_ROOT_stm32mp-t1000-k-sparkle-nor-nand          = "ubi.mtd=5 rootfstype=ubifs root=ubi0_0"
```

## layers/meta-ked/conf/distro/include/ked-base.inc
```bitbake
require conf/distro/poky.conf

TARGET_VENDOR = "-ked"

BB_SIGNATURE_HANDLER = "OEBasicHash"
BB_HASHSERVE ?= ""
```

## layers/meta-ked/conf/distro/ked.conf
```bitbake
require conf/distro/include/ked-base.inc

DISTRO = "ked"
DISTRO_NAME = "Kontron Electronics Reference Distro"
DISTRO_VERSION = "${@ '0.0.0-dev' if not d.getVar('SEMVER') else d.getVar('SEMVER') }"
BASE_SERIES ?= "undefined"
OVERRIDES =. "${BASE_SERIES}:"
DISTRO_CODENAME_SUFFIX ?= "${BASE_SERIES}"
DISTRO_CODENAME = "ked-${DISTRO_CODENAME_SUFFIX}"

IMAGE_VERSION_SUFFIX ?= "-${@ '${DATETIME}' if not d.getVar('SEMVER') else d.getVar('SEMVER') }"

SDK_VENDOR = "-kedsdk"
SDKPATHINSTALL = "/opt/kontron/${MACHINE}/${SDK_VERSION}"

MAINTAINER = "Kontron Electronics GmbH <support@kontron-electronics.de>"
TARGET_VENDOR = "-ked"

# =========================================================================
# misc settings
# =========================================================================
PACKAGE_FEED_URIS ?= "http://192.168.1.10/"

GCNANO_USERLAND_USE_VENDOR_DIR = "0"

# add the manifest and the licenses file on image generated
COPY_LIC_MANIFEST = "1"

# =========================================================================
# build info
# =========================================================================
BUILDCFG_VARS += "DISTRO_CODENAME"
BUILDCFG_VARS += "${@'ACCEPT_EULA_' + d.getVar('MACHINE')}"
BUILDCFG_VARS += "GCCVERSION"
BUILDCFG_VARS += "PREFERRED_PROVIDER_virtual/kernel"
BUILDCFG_VARS += "PREFERRED_VERSION_${PREFERRED_PROVIDER_virtual/kernel}"

# writes build information to target filesystem on /etc/build
IMAGE_BUILDINFO_VARS = "${BUILDCFG_VARS}"
INHERIT += "image-buildinfo"

# =========================================================================
# default/preferred providers/versions
# =========================================================================
PREFERRED_VERSION_libgpiod ?= "1.6.4"
PREFERRED_VERSION_util-linux = "2.38.1"
PREFERRED_VERSION_util-linux-libuuid = "2.38.1"
PREFERRED_VERSION_nativesdk-util-linux = "2.38.1"

# =========================================================================
# init system
# =========================================================================
VIRTUAL-RUNTIME_init_manager = "sysvinit"
VIRTUAL-RUNTIME_initscripts = "initscripts"
USE_VT = "0"

# =========================================================================
# distro features
# =========================================================================
DISTRO_FEATURES_BACKFILL_CONSIDERED += "systemd"
POKY_DEFAULT_DISTRO_FEATURES:remove = "vulkan wayland"
DISTRO_FEATURES:remove = "x11"
```

## layers/meta-ked/conf/layer.conf
```bitbake
# We have a conf and classes directory, add to BBPATH
BBPATH .= ":${LAYERDIR}"

# We have a packages directory, add to BBFILES
BBFILES += "${LAYERDIR}/recipes-*/*/*.bb \
            ${LAYERDIR}/recipes-*/*/*.bbappend"

BBFILE_COLLECTIONS += "ked"
BBFILE_PATTERN_ked := "^${LAYERDIR}/"
BBFILE_PRIORITY_ked = "10"

# Let us add layer-specific bbappends which are only applied when that
# layer is included in our configuration
BBFILES += "${@' '.join('${LAYERDIR}/%s/recipes*/*/*.bbappend' % layer \
               for layer in BBFILE_COLLECTIONS.split())}"

# Let us add layer-specific bbs which are only applied when that
# layer is included in our configuration
BBFILES += "${@' '.join('${LAYERDIR}/%s/recipes*/*/*.bb' % layer \
               for layer in BBFILE_COLLECTIONS.split())}"

# Let us add series-specific bbappends which are only applied if
# BASE_SERIES is set accordingly
BBFILES += "${LAYERDIR}/series-compat/${BASE_SERIES}/recipes*/*/*.bbappend"

# Let us add series-specific bbs which are only applied if
# BASE_SERIES is set accordingly
BBFILES += "${LAYERDIR}/series-compat/${BASE_SERIES}/recipes*/*/*.bb"

# Set Kontron server paths and repositories
KED_GIT_SERVER_SSH = "git@git.kontron-electronics.de"
KED_GIT_SERVER = "git.kontron-electronics.de"
KED_GIT_APPS   = "${KED_GIT_SERVER}/sw/misc/apps"
KED_GIT_USER ?= "ktn-user"
KED_GIT_PWD ?= "ktnuser"

# Set exceet server paths and repositories for compatibility
EXCEET_GIT_SERVER = "${KED_GIT_SERVER}"
EXCEET_GIT_APPS   = "${KED_GIT_APPS}"
EXCEET_GIT_USER ?= "${KED_GIT_USER}"
EXCEET_GIT_PWD ?= "${KED_GIT_PWD}"

LAYERVERSION_ked = "1"
LAYERSERIES_COMPAT_ked = "dunfell kirkstone"
LAYERDEPENDS_ked = "yocto"
```

## layers/meta-ktn-imx/conf/layer.conf
```bitbake
# We have a conf and classes directory, add to BBPATH
BBPATH .= ":${LAYERDIR}"

# We have a packages directory, add to BBFILES
BBFILES += "${LAYERDIR}/recipes-*/*/*.bb \
            ${LAYERDIR}/recipes-*/*/*.bbappend"

BBFILE_COLLECTIONS += "ktn-imx"
BBFILE_PATTERN_ktn-imx := "^${LAYERDIR}/"
BBFILE_PRIORITY_ktn-imx = "11"

# Let us add layer-specific bbappends which are only applied when that
# layer is included in our configuration
BBFILES += "${@' '.join('${LAYERDIR}/%s/recipes*/*/*.bbappend' % layer \
               for layer in BBFILE_COLLECTIONS.split())}"

# Let us add layer-specific bbs which are only applied when that
# layer is included in our configuration
BBFILES += "${@' '.join('${LAYERDIR}/%s/recipes*/*/*.bb' % layer \
               for layer in BBFILE_COLLECTIONS.split())}"

# Let us add series-specific bbappends which are only applied if
# BASE_SERIES is set accordingly
BBFILES += "${LAYERDIR}/series-compat/${BASE_SERIES}/recipes*/*/*.bbappend"

# Let us add series-specific bbs which are only applied if
# BASE_SERIES is set accordingly
BBFILES += "${LAYERDIR}/series-compat/${BASE_SERIES}/recipes*/*/*.bb"

LAYERVERSION_ktn-imx = "1"
LAYERSERIES_COMPAT_ktn-imx = "zeus dunfell"
LAYERDEPENDS_ktn-imx = "ktn freescale-layer"
LAYERDEPENDS_ktn-imx:append:mx8m-nxp-bsp = " meta-arm"
```
