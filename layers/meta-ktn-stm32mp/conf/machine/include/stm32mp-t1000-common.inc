## layers/meta-ktn/conf/distro/include/ktn-base.inc
```bitbake
require conf/distro/poky.conf

TARGET_VENDOR = "-ktn"

BB_SIGNATURE_HANDLER = "OEBasicHash"
BB_HASHSERVE ?= ""
```

## layers/meta-ktn/conf/distro/ktn.conf
```bitbake
DISTRO = "ktn"
DISTRO_NAME ?= "Kontron Electronics Reference Distro"
DISTRO_VERSION ?= "${@ '0.0.0-dev' if not d.getVar('SOURCECODE_VERSION') else d.getVar('SOURCECODE_VERSION') }"
DISTRO_CODENAME ?= "ktn-dunfell"

SDK_VENDOR = "-ktnsdk"
SDK_VERSION = "${@d.getVar('DISTRO_VERSION').replace('snapshot-${DATE}', 'snapshot')}"
SDK_NAME = "${DISTRO}-${TCLIBC}-${SDKMACHINE}-${IMAGE_BASENAME}-${TUNE_PKGARCH}-${MACHINE}"
SDKPATHINSTALL = "/opt/kontron/${MACHINE}/${SDK_VERSION}"

MAINTAINER ?= "Kontron Electronics GmbH <support@kontron-electronics.de>"
TARGET_VENDOR = "-ktn"

# =========================================================================
# misc settings
# =========================================================================
PACKAGE_FEED_URIS ?= "http://192.168.1.10/"

# remove '-g' because otherwise release-builds with
# the meta-toolchain are build with debugging symbols
FULL_OPTIMIZATION:remove = "-g"

DEPLOY_DIR_IMAGE = "${DEPLOY_DIR}/images/${MACHINE}"
IMAGE_NAME = "${IMAGE_BASENAME}-${MACHINE}-${DISTRO_CODENAME}-v${DISTRO_VERSION}-${DATE}"
IMAGE_NAME[vardepsexclude] = "TIME DATE DATETIME"

DISTRO_EXTRA_RDEPENDS = "packagegroup-core-boot"
DISTRO_EXTRA_RRECOMMENDS = "kernel-module-af-packet"

GCNANO_USERLAND_USE_VENDOR_DIR = "0"

# add the manifest and the licenses file on image generated
COPY_LIC_MANIFEST = "1"

# =========================================================================
# include some basic settings copied from poky
# =========================================================================
require conf/distro/include/ktn-base.inc

# =========================================================================
# build info
# =========================================================================
BUILDCFG_VARS += "DISTRO_CODENAME"
BUILDCFG_VARS += "${@'ACCEPT_EULA_' + d.getVar('MACHINE')}"
BUILDCFG_VARS += "GCCVERSION"
BUILDCFG_VARS += "PREFERRED_PROVIDER_virtual/kernel"
BUILDCFG_VARS += "PREFERRED_VERSION_${PREFERRED_PROVIDER_virtual/kernel}"

# writes build information to target filesystem on /etc/build
IMAGE_BUILDINFO_VARS = "${BUILDCFG_VARS}"
INHERIT += "image-buildinfo"

# =========================================================================
# default/preferred providers
# =========================================================================
PREFERRED_PROVIDER_libevent = "libevent-fb"
PREFERRED_PROVIDER_jpeg = "libjpeg-turbo"
PREFERRED_PROVIDER_jpeg-native = "libjpeg-turbo-native"

# =========================================================================
# init system
# =========================================================================
VIRTUAL-RUNTIME_init_manager = "sysvinit"
VIRTUAL-RUNTIME_initscripts = "initscripts"

# =========================================================================
# distro features
# =========================================================================
DISTRO_FEATURES_BACKFILL_CONSIDERED += "systemd"

DISTRO_FEATURES = " \
	alsa \
	argp \
	bluetooth \
	bluez5 \
	ext2 \
	ext4 \
	gplv3 \
	gstreamer \
	ipv4 \
	ipv6 \
	largefile \
	multiarch \
	nfs \
	opengl \
	optee \
	pam \
	pulseaudio \
	usbgadget \
	usbhost \
	wifi \
	xattr \
	zeroconf \
	${DISTRO_FEATURES_LIBC} \
"
```

## layers/meta-ktn/conf/layer.conf
```bitbake
# We have a conf and classes directory, add to BBPATH
BBPATH .= ":${LAYERDIR}"

# We have a packages directory, add to BBFILES
BBFILES += "${LAYERDIR}/recipes-*/*/*.bb \
            ${LAYERDIR}/recipes-*/*/*.bbappend"

BBFILE_COLLECTIONS += "ktn"
BBFILE_PATTERN_ktn := "^${LAYERDIR}/"
BBFILE_PRIORITY_ktn = "10"

# Let us add layer-specific bbappends which are only applied when that
# layer is included in our configuration
BBFILES += "${@' '.join('${LAYERDIR}/%s/recipes*/*/*.bbappend' % layer \
               for layer in BBFILE_COLLECTIONS.split())}"

# Let us add layer-specific bbs which are only applied when that
# layer is included in our configuration
BBFILES += "${@' '.join('${LAYERDIR}/%s/recipes*/*/*.bb' % layer \
               for layer in BBFILE_COLLECTIONS.split())}"

# Let us add series-specific bbappends which are only applied if
# BASE_SERIES is set accordingly
BBFILES += "${LAYERDIR}/series-compat/${BASE_SERIES}/recipes*/*/*.bbappend"

# Let us add series-specific bbs which are only applied if
# BASE_SERIES is set accordingly
BBFILES += "${LAYERDIR}/series-compat/${BASE_SERIES}/recipes*/*/*.bb"

HOSTTOOLS:append = "xxd"

# Set Kontron server paths and repositories
KTN_GIT_SERVER_SSH = "git@git.kontron-electronics.de"
KTN_GIT_SERVER = "git.kontron-electronics.de"
KTN_GIT_APPS   = "${KTN_GIT_SERVER}/sw/misc/apps"
KTN_GIT_USER ?= "ktn-user"
KTN_GIT_PWD ?= "ktnuser"

# Set exceet server paths and repositories for compatibility
EXCEET_GIT_SERVER = "${KTN_GIT_SERVER}"
EXCEET_GIT_APPS   = "${KTN_GIT_APPS}"
EXCEET_GIT_USER ?= "${KTN_GIT_USER}"
EXCEET_GIT_PWD ?= "${KTN_GIT_PWD}"

LAYERVERSION_ktn = "1"
LAYERSERIES_COMPAT_ktn = "zeus dunfell"
LAYERDEPENDS_ktn = "yocto openembedded-layer"
```
